## FilesToCopy/ACU6apps/HelloACU6/externals/myproj/configs/myproj_defconfig
```kconfig
BR2_aarch64=y
BR2_cortex_a35=y
BR2_TOOLCHAIN_EXTERNAL=y
BR2_CCACHE=y
BR2_GLOBAL_PATCH_DIR="$(BR2_EXTERNAL_ACU6_BASE_PATH)/patches"
BR2_PER_PACKAGE_DIRECTORIES=y
BR2_ROOTFS_DEVICE_CREATION_DYNAMIC_EUDEV=y
# BR2_TARGET_GENERIC_REMOUNT_ROOTFS_RW is not set
BR2_ROOTFS_OVERLAY="$(BR2_EXTERNAL_ACU6_BASE_PATH)/board/actia/acu6/rootfs_overlay  $(BR2_EXTERNAL_ACU6_DEMOS_PATH)/board/actia/acu6/rootfs_overlay"
BR2_ROOTFS_POST_BUILD_SCRIPT="$(BR2_EXTERNAL_ACU6_BASE_PATH)/board/actia/acu6/post-build.sh"
BR2_ROOTFS_POST_IMAGE_SCRIPT="$(BR2_EXTERNAL_ACU6_BASE_PATH)/board/actia/acu6/post-image.sh"
BR2_LINUX_KERNEL=y
BR2_LINUX_KERNEL_CUSTOM_VERSION=y
BR2_LINUX_KERNEL_CUSTOM_VERSION_VALUE="6.1.14"
BR2_LINUX_KERNEL_USE_CUSTOM_CONFIG=y
BR2_LINUX_KERNEL_CUSTOM_CONFIG_FILE="$(BR2_EXTERNAL_ACU6_BASE_PATH)/board/actia/acu6/linux-6.1.config"
BR2_PACKAGE_BUSYBOX_CONFIG="$(BR2_EXTERNAL_ACU6_BASE_PATH)/board/actia/acu6/busybox.config"
BR2_PACKAGE_BUSYBOX_SHOW_OTHERS=y
BR2_PACKAGE_E2FSPROGS=y
BR2_PACKAGE_RNG_TOOLS=y
BR2_PACKAGE_CAN_UTILS=y
BR2_PACKAGE_DROPBEAR=y
# BR2_PACKAGE_DROPBEAR_CLIENT is not set
BR2_PACKAGE_IPERF3=y
BR2_PACKAGE_IPROUTE2=y
BR2_PACKAGE_NETCAT=y
BR2_TARGET_ROOTFS_SQUASHFS=y
BR2_PACKAGE_ACTIA_TIMESYNC=y
BR2_PACKAGE_LIBBTSTACK=y
BR2_PACKAGE_USBIP_CLIENT=y
BR2_PACKAGE_USBIP=y
BR2_PACKAGE_ACTIA_ACCELEROMETER_DEMO=y
BR2_PACKAGE_ACTIA_ADC_DEMO=y
BR2_PACKAGE_ACTIA_BUB_DEMO=y
BR2_PACKAGE_ACTIA_DIAGNOSTICS_DEMO=y
BR2_PACKAGE_ACTIA_DIGITAL_INPUTS_DEMO=y
BR2_PACKAGE_ACTIA_DIGITAL_OUTPUTS_DEMO=y
BR2_PACKAGE_ACTIA_ETHERNET_DEMO=y
BR2_PACKAGE_ACTIA_GYROSCOPE_DEMO=y
BR2_PACKAGE_ACTIA_HWINFO_DEMO=y
BR2_PACKAGE_ACTIA_IO_DEMO=y
BR2_PACKAGE_ACTIA_IPC_DEMO=y
BR2_PACKAGE_ACTIA_MINIMAL_IPC_DEMO=y
BR2_PACKAGE_ACTIA_MODEMCONTROL_DEMO=y
BR2_PACKAGE_ACTIA_POSITION_DEMO=y
BR2_PACKAGE_ACTIA_RTC_DEMO=y
BR2_PACKAGE_ACTIA_SERIAL_DEMO=y
BR2_PACKAGE_ACTIA_SHOULDERTAP_DEMO=y
BR2_PACKAGE_ACTIA_SOCKETCAN_DEMO=y
BR2_PACKAGE_ACTIA_SOFTWAREUPDATE_DEMO=y
BR2_PACKAGE_ACTIA_WIFI_DEMO=y
BR2_PACKAGE_LIBSTDBUF=y
```

## FilesToCopy/ACU6apps/HelloACU6/externals/myproj/package/hello-acu6/Config.in
```kconfig
config BR2_PACKAGE_HELLO_ACU6
	bool "hello-acu6"
	help
	   Hello ACU6 demo application
```
